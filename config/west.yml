## config/west.yml
```yaml
manifest:
  remotes:
    - name: zmkfirmware
      url-base: https://github.com/zmkfirmware
  projects:
    - name: zmk
      remote: zmkfirmware
      revision: 168b32b8288ba36831f262f82bfa166240506676
      import: app/west.yml
  self:
    path: config
```
